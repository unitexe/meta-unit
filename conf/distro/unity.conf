## conf/distro/unity.conf
```bitbake
# Based on poky.
require conf/distro/poky.conf

# Override base distro.
DISTROOVERRIDES = "poky"

# Customization needed.
require unity.inc
```

## conf/distro/unity.inc
```bitbake
DISTRO = "unity"

INIT_MANAGER = "systemd"

# Graphics
DISTRO_FEATURES:append = " opengl"

# Containers
DISTRO_FEATURES:append = " virtualization"
DISTRO_FEATURES:append = " pam"
```

## conf/layer.conf
```bitbake
BBPATH .= ":${LAYERDIR}"

BBFILES += "${LAYERDIR}/recipes*/*/*.bb ${LAYERDIR}/recipes*/*/*.bbappend"

BBFILE_COLLECTIONS += "meta-unit"
BBFILE_PATTERN_meta-unit := "^${LAYERDIR}/"
BBFILE_PRIORITY_meta-unit = "14"

LAYERDEPENDS_meta-unit = "core openembedded-layer meta-unit-apps meta-python-extra meta-unit-profiling meta-unit-networking meta-unit-ebpf"

LAYERSERIES_COMPAT_meta-unit = "walnascar whinlatter"
```
